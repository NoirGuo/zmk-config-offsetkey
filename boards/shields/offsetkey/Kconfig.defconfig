## boards/shields/offsetkey/Kconfig.defconfig
```kconfig
# 板定义，这里定义右手
if SHIELD_OFFSETKEY_RIGHT

# 定义键盘显示名称
config ZMK_KEYBOARD_NAME
	default "offsetkey"

# 定义右手为主手，offsetkey引用的3610轨迹球驱动要求球必须在主手。如果是定义左手为主手，最上面那一行RIGHT改成LEFT
config ZMK_SPLIT_BLE_ROLE_CENTRAL
	default y

# 有if就必须有endif，一一对应
endif

# 两只手一起定义
if SHIELD_OFFSETKEY_LEFT || SHIELD_OFFSETKEY_RIGHT

# 是否为分体键盘
config ZMK_SPLIT
	default y
	
endif

# 定义屏幕显示
if ZMK_DISPLAY

# SSD3610 OELD屏幕信号走I2C通道
config I2C
    default y

# 使用SSD1306屏幕驱动
config SSD1306
    default y

# 选择专用的屏幕更新线程
choice ZMK_DISPLAY_WORK_QUEUE
    default ZMK_DISPLAY_WORK_QUEUE_DEDICATED
endchoice

endif

# 屏幕参数设置，分辨率啥的
if LVGL

config LV_Z_VDB_SIZE
    default 64

config LV_DPI_DEF
    default 148

config LV_Z_BITS_PER_PIXEL
    default 1

choice LV_COLOR_DEPTH
    default LV_COLOR_DEPTH_1
endchoice

endif


# 屏幕背光设置
if ZMK_BACKLIGHT

config PWM
    default y

config LED_PWM
    default y

endif # ZMK_BACKLIGHT


# 下面这俩是启用主控板的DCDC电路，更省电。如果没有焊接对应的元件，请勿启用
config BOARD_ENABLE_DCDC
    bool "Enable DCDC mode"
    select SOC_DCDC_NRF52X
    default y
    depends on (SHIELD_OFFSETKEY_LEFT || SHIELD_OFFSETKEY_RIGHT)

config BOARD_ENABLE_DCDC_HV
    bool "Enable High Voltage DCDC converter"
    default y
    select SOC_DCDC_NRF52X_HV
    depends on (SHIELD_OFFSETKEY_LEFT || SHIELD_OFFSETKEY_RIGHT)
```

## boards/shields/offsetkey/Kconfig.shield
```kconfig
# 指定编译哪个键盘，括号里的内容要和对应的文件名匹配

config SHIELD_OFFSETKEY_LEFT
    def_bool $(shields_list_contains,offsetkey_left)

config SHIELD_OFFSETKEY_RIGHT
    def_bool $(shields_list_contains,offsetkey_right)
```

## config/west.yml
```yaml
# 引用的官方仓库和第三方仓库
# 可以按需修改、增加和删除，但要注意格式符合要求
manifest:
  remotes:
    - name: zmkfirmware
      url-base: https://github.com/zmkfirmware # 官方仓库的远程名称
    - name: cormoran
      url-base: https://github.com/cormoran #以下几个都是第三方仓库的远程名称
    - name: kumamuk-git
      url-base: https://github.com/kumamuk-git
    - name: badjeff
      url-base: https://github.com/badjeff
    - name: mctechnology17
      url-base: https://github.com/mctechnology17
    - name: eyelash
      url-base: https://github.com/a741725193
    - name: infused-kim
      url-base: https://github.com/infused-kim
    - name: a741725193
      url-base: https://github.com/a741725193
  projects:
    - name: zmk # 仓库名称，如下所示，可以引用同一个人的不同仓库。这个是zmk的基础仓库
      remote: cormoran # 仓库的远程名称，必须与上面定义的远程名称一致
      revision: v0.3-branch+dya # 仓库的分支或标签，必须与远程仓库的分支或标签一致
      import: app/west.yml
    - name: zmk-behavior-runtime-sensor-rotate # 这个是滚轮相关功能的依赖。远程名称+仓库名称+分支名称就是引用的仓库地址，比如这一部分，最终指向https://github.com/cormoran/zmk-behavior-runtime-sensor-rotate/tree/main 这个地址
      remote: cormoran
      revision: main
    - name: zmk-module-ble-management # 蓝牙管理
      remote: cormoran
      revision: 851661cd21f2aded8ec649da86e01a207dc4b973 # 仓库的分支的另一种写法，剑心大佬写的，我水平有限，不知道啥原理，有屌大的给解释一下
    - name: zmk-module-battery-history # 电池历史记录
      remote: cormoran
      revision: main
    - name: zmk-module-settings-rpc # 设置模块
      remote: cormoran
      revision: main
    - name: zmk-module-runtime-input-processor # 输入处理器
      remote: cormoran
      revision: dbf92f764de8b6ffd60bf5850514302875fe2570
    - name: zmk-pmw3610-driver # pmw3610驱动
      remote: cormoran
      revision: 274c92bec8a0e98499ceff653b8b9bd6486effbe
    - name: zmk-nice-oled # nice!view驱动
      remote: mctechnology17
      revision: main
    - name: zmk-board-eyelash # 睫毛哥的主控板
      remote: eyelash
      revision: main
    - name: kb_zmk_ps2_mouse_trackpoint_driver # 指点杆或者触控板驱动
      remote: infused-kim
      revision: main
    - name: zmk-tog-io # 睫毛哥的io切换驱动
      remote: a741725193
      revision: main
  self:
    path: config
```
