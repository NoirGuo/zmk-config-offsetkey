// === WS2812 RGB灯珠配置 ===
// 引用ZMK官方LED定义
#include <dt-bindings/led/led.h>
// 下面大部分是固定格式，不需要修改
&spi3 {
    compatible = "nordic,nrf-spim";
    status = "okay";

    pinctrl-0 = <&spi3_default>;
    pinctrl-1 = <&spi3_sleep>;
    pinctrl-names = "default", "sleep";

    led_strip: ws2812@0 {
        compatible = "worldsemi,ws2812-spi";

        /* SPI */
        reg = <0>; /* ignored, but necessary for SPI bindings */
        spi-max-frequency = <4000000>;

        /* WS2812 */
        // 这一行是灯带长度，按单手的数量计算。实际好像没啥影响，offsetkey真机几十颗灯也都亮起来了
        chain-length = <10>; /* 6 keys have underglow at the moment */
        spi-one-frame = <0x70>;
        spi-zero-frame = <0x40>;
        // RGB 通道重映射，匹配实际 WS2812 灯珠数据顺序，默认是GRB，如果颜色错乱，需要调整RGB顺序调试
        color-mapping = <LED_COLOR_ID_GREEN LED_COLOR_ID_RED LED_COLOR_ID_BLUE>;
    };
};